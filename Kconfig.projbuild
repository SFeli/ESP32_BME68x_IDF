## Kconfig.projbuild
```kconfig
# put here your custom config value
menu "BME680 Configuration"

config I2C_MASTER_SCL
    int "SCL GPIO Num"
#    range ENV_GPIO_RANGE_MIN ENV_GPIO_OUT_RANGE_MAX
    default 23 if IDF_TARGET_ESP32 || IDF_TARGET_ESP32S2 || IDF_TARGET_ESP32S3
    default 6
    help
        GPIO number for I2C Master clock line.

config I2C_MASTER_SDA
    int "SDA GPIO Num"
#    range ENV_GPIO_RANGE_MIN ENV_GPIO_OUT_RANGE_MAX
    default 18 if IDF_TARGET_ESP32 || IDF_TARGET_ESP32S2 || IDF_TARGET_ESP32S3
    default 5
    help
        GPIO number for I2C Master data line.

config I2C_MASTER_NUM
    int "MASTER Num"
    range 0 1
    default 0
    help
	I2C master i2c port number, the number of i2c peripheral interfaces available will depend on the chip

config BME68X_ADDR
    hex "BME68X Address"
#    range ENV_GPIO_RANGE_MIN ENV_GPIO_OUT_RANGE_MAX
    default 0x77
    help
        GPIO number for I2C Master data line.

endmenu
```
